BO_ 500 IO_DEBUG_msg1: 4 IO
 SG_ IO_DEBUG_msg1_sig1 : 0|8@1+ (1,0) [0|0] "" DBG
